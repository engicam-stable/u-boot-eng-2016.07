## board/engicam/geal-mx6ull/Kconfig
```kconfig
if TARGET_GEAL_MX6ULL

config SYS_BOARD
	default "geal-mx6ull"

config SYS_VENDOR
	default "engicam"

config SYS_CONFIG_NAME
	default "geal-mx6ull"

endif
```

## board/engicam/geam6ul/Kconfig
```kconfig
if TARGET_GEAM6UL

config SYS_BOARD
	default "geam6ul"

config SYS_VENDOR
	default "engicam"

config SYS_CONFIG_NAME
	default "geam6ul"

endif
```

## board/engicam/icore_mx6sx/Kconfig
```kconfig
if TARGET_ICORE_MX6SX

config SYS_BOARD
	default "icore_mx6sx"

config SYS_VENDOR
	default "engicam"

config SYS_SOC
	default "mx6"

config SYS_CONFIG_NAME
	default "icore_mx6sx"

endif
```

## board/engicam/icorem6/Kconfig
```kconfig
if TARGET_ICOREM6

config SYS_BOARD
	default "icorem6"

config SYS_VENDOR
	default "engicam"

config SYS_SOC
	default "mx6"

config SYS_CONFIG_NAME
	default "icorem6"

endif
```

## board/engicam/icorem6rqs/Kconfig
```kconfig
if TARGET_ICOREM6RQS

config SYS_BOARD
	default "icorem6rqs"

config SYS_VENDOR
	default "engicam"

config SYS_SOC
	default "mx6"

config SYS_CONFIG_NAME
	default "icorem6rqs"

endif
```

## board/engicam/isiot/Kconfig
```kconfig
if TARGET_ISIOT

config SYS_BOARD
	default "isiot"

config SYS_VENDOR
	default "engicam"

config SYS_CONFIG_NAME
	default "isiot"

endif
```

## board/engicam/microgea-mx6ull/Kconfig
```kconfig
if TARGET_MICROGEA_MX6ULL

config SYS_BOARD
	default "microgea-mx6ull"

config SYS_VENDOR
	default "engicam"

config SYS_CONFIG_NAME
	default "microgea-mx6ull"

endif
```

## board/engicam/microgea-y1/Kconfig
```kconfig
if TARGET_MICROGEA_Y1

config SYS_BOARD
	default "microgea-y1"

config SYS_VENDOR
	default "engicam"

config SYS_CONFIG_NAME
	default "microgea-y1"

endif
```

## board/engicam/smarcore-mx6sx/Kconfig
```kconfig
if TARGET_SMARCORE_MX6SX

config SYS_BOARD
	default "smarcore-mx6sx"

config SYS_VENDOR
	default "engicam"

config SYS_SOC
	default "mx6"

config SYS_CONFIG_NAME
	default "smarcore-mx6sx"

endif
```

## configs/geamx6ul_emmc_defconfig
```kconfig
# Config for GEA M6UL
# boot from eMMC version
#
CONFIG_ARM=y
CONFIG_ARCH_MX6=y
CONFIG_TARGET_GEAM6UL=y
#CONFIG_SPL=y
#CONFIG_SYS_EXTRA_OPTIONS="IMX_CONFIG=arch/arm/imx-common/spl_sd.cfg"
CONFIG_SYS_EXTRA_OPTIONS="IMX_CONFIG=board/engicam/geam6ul/imximage.cfg,SYS_BOOT_EMMC,SYS_MMC_ENV_DEV=1"
CONFIG_BOOTDELAY=3
CONFIG_HUSH_PARSER=y
CONFIG_CMD_BOOTZ=y
# CONFIG_CMD_IMLS is not set
CONFIG_CMD_MEMTEST=y
CONFIG_CMD_MMC=y
CONFIG_CMD_I2C=y
CONFIG_CMD_USB=y
CONFIG_CMD_GPIO=y
CONFIG_CMD_DHCP=y
CONFIG_CMD_PING=y
CONFIG_CMD_CACHE=y
CONFIG_CMD_EXT2=y
CONFIG_CMD_EXT4=y
CONFIG_CMD_EXT4_WRITE=y
CONFIG_CMD_FAT=y
CONFIG_CMD_FS_GENERIC=y
CONFIG_OF_LIBFDT=y
```

## configs/icoremx6dlrqs_emmc_defconfig
```kconfig
CONFIG_ARM=y
CONFIG_ARCH_MX6=y
CONFIG_TARGET_ICOREM6RQS=y
CONFIG_SYS_EXTRA_OPTIONS="IMX_CONFIG=board/engicam/icorem6rqs/icoremx6rqsdl.cfg,MX6DL,ENV_IS_IN_MMC,SYS_BOOT_EMMC"
CONFIG_BOOTDELAY=1
CONFIG_HUSH_PARSER=y
CONFIG_CMD_BOOTZ=y
# CONFIG_CMD_IMLS is not set
# CONFIG_CMD_FLASH is not set
CONFIG_CMD_MMC=y
#CONFIG_CMD_SF=y
CONFIG_CMD_I2C=y
CONFIG_CMD_USB=y
#CONFIG_CMD_DFU=y
#CONFIG_CMD_USB_MASS_STORAGE=y
CONFIG_CMD_GPIO=y
CONFIG_CMD_DHCP=y
CONFIG_CMD_MII=y
CONFIG_CMD_PING=y
CONFIG_CMD_CACHE=y
CONFIG_CMD_EXT2=y
CONFIG_CMD_EXT4=y
CONFIG_CMD_EXT4_WRITE=y
CONFIG_CMD_FAT=y
CONFIG_CMD_FS_GENERIC=y
#CONFIG_SPI_FLASH=y
#CONFIG_SPI_FLASH_STMICRO=y
CONFIG_USB=y
#CONFIG_USB_GADGET=y
CONFIG_CI_UDC=y
#CONFIG_USB_GADGET_DOWNLOAD=y
CONFIG_G_DNL_MANUFACTURER="FSL"
CONFIG_G_DNL_VENDOR_NUM=0x0525
CONFIG_G_DNL_PRODUCT_NUM=0xa4a5
CONFIG_OF_LIBFDT=y
CONFIG_CMD_MEMTEST=y
```

## configs/microgea_mx6ull_1GB_sd_defconfig
```kconfig
# Config for GEA M6UL
# boot from SD version
#
CONFIG_ARM=y
CONFIG_ARCH_MX6=y
CONFIG_TARGET_MICROGEA_MX6ULL=y
#CONFIG_SPL=y
#CONFIG_SYS_EXTRA_OPTIONS="IMX_CONFIG=arch/arm/imx-common/spl_sd.cfg"
CONFIG_SYS_EXTRA_OPTIONS="IMX_CONFIG=board/engicam/microgea-mx6ull/imximage.cfg,SYS_USE_NAND,SDRAM_SIZE_1GB"
CONFIG_BOOTDELAY=3
CONFIG_HUSH_PARSER=y
CONFIG_CMD_BOOTZ=y
# CONFIG_CMD_IMLS is not set
CONFIG_CMD_MEMTEST=y
CONFIG_CMD_MMC=y
CONFIG_CMD_I2C=y
CONFIG_CMD_USB=y
CONFIG_CMD_GPIO=y
CONFIG_CMD_DHCP=y
CONFIG_CMD_PING=y
CONFIG_CMD_CACHE=y
CONFIG_CMD_EXT2=y
CONFIG_CMD_EXT4=y
CONFIG_CMD_EXT4_WRITE=y
CONFIG_CMD_FAT=y
CONFIG_CMD_FS_GENERIC=y
CONFIG_OF_LIBFDT=y
```

## configs/smarcorem6sx_emmc_defconfig
```kconfig
CONFIG_SYS_EXTRA_OPTIONS="IMX_CONFIG=board/engicam/smarcore-mx6sx/imximage.cfg,MX6SX,DDR_MB=512,ENV_IS_IN_MMC,SYS_BOOT_EMMC"
CONFIG_ARM=y
CONFIG_TARGET_SMARCORE_MX6SX=y
CONFIG_DM=y
CONFIG_DM_THERMAL=y
```
